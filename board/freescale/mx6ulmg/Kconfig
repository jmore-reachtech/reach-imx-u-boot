## board/freescale/mx6ulmg/Kconfig
```kconfig
if TARGET_MX6ULMG

config SYS_BOARD
	default "mx6ulmg"

config SYS_VENDOR
	default "freescale"

config SYS_SOC
	default "mx6"

config SYS_CONFIG_NAME
	default "mx6ulmg"

endif
```

## board/reach/g2h/Kconfig
```kconfig
if TARGET_G2H

config SYS_BOARD
	default "g2h"

config SYS_VENDOR
	default "reach"

config SYS_CONFIG_NAME
	default "g2h"

endif
```

## board/reach/imx6dl-g3/Kconfig
```kconfig
if TARGET_IMX6DL_G3

config SYS_BOARD
	default "imx6dl-g3"

config SYS_VENDOR
	default "reach"

config SYS_CONFIG_NAME
	default "imx6dl-g3"

endif
```

## configs/g2h_solo_12f_spi_nor_defconfig
```kconfig
CONFIG_ARM=y
CONFIG_ARCH_MX6=y
CONFIG_TARGET_G2H=y
CONFIG_SYS_EXTRA_OPTIONS="IMX_CONFIG=board/reach/g2h/g2h_solo.cfg,MX6DL,LCD_10_1,SOLO_12f,BOOT_FROM_SPI"
```

## configs/g2h_solo_3f_spi_nor_defconfig
```kconfig
CONFIG_ARM=y
CONFIG_ARCH_MX6=y
CONFIG_TARGET_G2H=y
CONFIG_SYS_EXTRA_OPTIONS="IMX_CONFIG=board/reach/g2h/g2h_solo.cfg,MX6DL,LCD_7,SOLO_3f,BOOT_FROM_SPI"
```

## configs/mx6ulmg_defconfig
```kconfig
CONFIG_SYS_EXTRA_OPTIONS="IMX_CONFIG=board/freescale/mx6ulmg/imximage.cfg"
CONFIG_ARM=y
CONFIG_ARCH_MX6=y
CONFIG_TARGET_MX6ULMG=y
CONFIG_BOOTDELAY=3
CONFIG_CMD_GPIO=y
CONFIG_CMD_DHCP=y
CONFIG_CMD_PING=y
CONFIG_DDR3L_MT41K128M16JT-125=y
CONFIG_BOARD_EARLY_INIT_F=y
CONFIG_HUSH_PARSER=y
CONFIG_CMD_BOOTZ=y
CONFIG_CMD_MEMTEST=y
CONFIG_CMD_MMC=y
CONFIG_CMD_PART=y
CONFIG_CMD_FAT=y
CONFIG_CMD_FS_GENERIC=y
CONFIG_CMD_EXT2=y
CONFIG_CMD_EXT4=y
CONFIG_CMD_EXT4_WRITE=y
# CONFIG_CMD_IMLS is not set
# CONFIG_CMD_FLASH is not set
CONFIG_OF_LIBFDT=y
CONFIG_OF_LIBFDT_OVERLAY=y
CONFIG_DEFAULT_FDT_FILE="imx6ul-volansys-gw.dtb"
```

## configs/reach_rd6_7p_defconfig
```kconfig
CONFIG_ARM=y
CONFIG_ARCH_MX6=y
CONFIG_SYS_TEXT_BASE=0x17800000
CONFIG_TARGET_G2H=y
CONFIG_NR_DRAM_BANKS=1
CONFIG_SYS_EXTRA_OPTIONS="IMX_CONFIG=board/reach/g2h/g2h_solo.cfg,MX6DL"
# CONFIG_CONSOLE_MUX is not set
CONFIG_SYS_CONSOLE_IS_IN_ENV=y
CONFIG_SYS_CONSOLE_OVERWRITE_ROUTINE=y
CONFIG_DEFAULT_FDT_FILE="imx6dl-g2h-7p.dtb"
CONFIG_BOARD_EARLY_INIT_F=y
CONFIG_HUSH_PARSER=y
CONFIG_CMD_BOOTZ=y
CONFIG_CMD_I2C=y
CONFIG_CMD_MMC=y
CONFIG_CMD_MTD=y
CONFIG_CMD_NAND_TRIMFFS=y
CONFIG_CMD_PART=y
CONFIG_CMD_SF=y
CONFIG_CMD_DHCP=y
CONFIG_CMD_MII=y
CONFIG_CMD_PING=y
CONFIG_CMD_BMP=y
CONFIG_CMD_EXT4=y
CONFIG_CMD_FAT=y
CONFIG_CMD_FS_GENERIC=y
CONFIG_EFI_PARTITION=y
CONFIG_ENV_IS_IN_MMC=y
CONFIG_BOOTCOUNT_LIMIT=y
CONFIG_BOOTCOUNT_ENV=y
CONFIG_SYS_I2C_MXC=y
CONFIG_SYS_I2C_MXC_I2C1=y
CONFIG_FSL_ESDHC=y
CONFIG_NAND=y
CONFIG_NAND_MXS=y
CONFIG_SPI_FLASH=y
CONFIG_SPI_FLASH_STMICRO=y
CONFIG_PHYLIB=y
CONFIG_PHY_ATHEROS=y
CONFIG_FEC_MXC=y
CONFIG_MII=y
CONFIG_MXC_UART=y
CONFIG_SPI=y
CONFIG_MXC_SPI=y
CONFIG_VIDEO=y
CONFIG_VIDEO_IPUV3=y
CONFIG_OF_LIBFDT=y
```
